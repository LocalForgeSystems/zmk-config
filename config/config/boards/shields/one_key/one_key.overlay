
#include <dt-bindings/gpio/gpio.h>

/ {
    chosen {
        zmk,kscan = &one_key_kscan;
    };

    one_key_kscan: one_key_kscan {
        compatible = "zmk,kscan-gpio-direct";
        input-gpios = <&gpio0 17 (GPIO_ACTIVE_LOW | GPIO_PULL_UP)>;
    };
};
